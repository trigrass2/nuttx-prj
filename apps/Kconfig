## apps/my_project/beacon_service/Kconfig
```kconfig
menu "Beacon service"

config BEACON_TASK_PRIORITY
	int "Beacon service task priority"
	default 205
	range 100 250
	---help---
		beacon service task priority, allowed values {100,250} 

config BEACON_TX_THREAD_PRIORITY
	int "Beacon send thread priority"
	default 160
	range 50 250
	---help---
		beacon send thread priority, allowed values {50,250} 

config BEACONSERVICE_PUBLISH_BEACON_DATA
	bool "beacon service task publish beacon"
	default 1
	---help---
		beacon service task publish beacon

endmenu # Beacon service
```

## apps/my_project/example/arm_basic_math_example/Kconfig
```kconfig
#
# For a description of the syntax of this configuration file,
# see the file kconfig-language.txt in the NuttX tools repository.
#

config EXAMPLES_ARM_BASIC_MATH
	bool "arm basic math example"
	default n
	---help---
		Enable the arm basic math example

if EXAMPLES_ARM_BASIC_MATH

config EXAMPLES_ARM_BASIC_MATH_PROGNAME
	string "Program name"
	default "arm_basic_math_example"
	---help---
		This is the name of the program that will be use when the NSH ELF
		program is installed.

config EXAMPLES_ARM_BASIC_MATH_PRIORITY
	int "arm basic math example task priority"
	default 100

config EXAMPLES_ARM_BASIC_MATH_STACKSIZE
	int "arm basic math example stack size"
	default 2048

endif
```

## apps/my_project/example/complex_math_example/Kconfig
```kconfig
#
# For a description of the syntax of this configuration file,
# see the file kconfig-language.txt in the NuttX tools repository.
#

config EXAMPLES_COMPLX_MATH
	bool "complex math example"
	default n
	---help---
		Enable the complex math example

if EXAMPLES_COMPLX_MATH

config EXAMPLES_COMPLX_MATH_PROGNAME
	string "Program name"
	default "complex_math_example"
	---help---
		This is the name of the program that will be use when the NSH ELF
		program is installed.

config EXAMPLES_COMPLX_MATH_PRIORITY
	int "complex math example task priority"
	default 100

config EXAMPLES_COMPLX_MATH_STACKSIZE
	int "complex math example stack size"
	default 2048

endif
```

## apps/my_project/example/eeprom_xx24xx_example/Kconfig
```kconfig
#
# For a description of the syntax of this configuration file,
# see the file kconfig-language.txt in the NuttX tools repository.
#

config EXAMPLES_EEPROM_XX24XX
	bool "EEPROM_XX24XX example"
	default n
	---help---
		Enable the EEPROM_XX24XX example

if EXAMPLES_EEPROM_XX24XX

config EXAMPLES_EEPROM_XX24XX_PROGNAME
	string "Program name"
	default "eeprom_xx24xx_example"
	---help---
		This is the name of the program that will be use when the NSH ELF
		program is installed.

config EXAMPLES_EEPROM_XX24XX_PRIORITY
	int "EEPROM_XX24XX example task priority"
	default 100

config EXAMPLES_EEPROM_XX24XX_STACKSIZE
	int "EEPROM_XX24XX example stack size"
	default 2048

endif
```

## apps/my_project/example/hmc6343_example/Kconfig
```kconfig
#
# For a description of the syntax of this configuration file,
# see the file kconfig-language.txt in the NuttX tools repository.
#

config EXAMPLES_HMC6343
	bool "Honeywell HMC6343 example"
	default n
	---help---
		Enable the Honeywell HMC6343 example

if EXAMPLES_HMC6343

config EXAMPLES_HMC6343_PROGNAME
	string "Program name"
	default "hmc6343_example"
	---help---
		This is the name of the program that will be use when the NSH ELF
		program is installed.

config EXAMPLES_HMC6343_PRIORITY
	int "Honeywell HMC6343 example task priority"
	default 100

config EXAMPLES_HMC6343_STACKSIZE
	int "Honeywell HMC6343 example stack size"
	default 2048

endif
```

## apps/my_project/example/matrix_math_example/Kconfig
```kconfig
#
# For a description of the syntax of this configuration file,
# see the file kconfig-language.txt in the NuttX tools repository.
#

config EXAMPLES_MATRIX_MATH
	bool "matrix math example"
	default n
	---help---
		Enable the matrix math example

if EXAMPLES_MATRIX_MATH

config EXAMPLES_MATRIX_MATH_PROGNAME
	string "Program name"
	default "matrix_math_example"
	---help---
		This is the name of the program that will be use when the NSH ELF
		program is installed.

config EXAMPLES_MATRIX_MATH_PRIORITY
	int "matrix math example task priority"
	default 100

config EXAMPLES_MATRIX_MATH_STACKSIZE
	int "matrix math example stack size"
	default 2048

endif
```

## apps/my_project/example/motor_pwm_io_example/Kconfig
```kconfig
#
# For a description of the syntax of this configuration file,
# see the file kconfig-language.txt in the NuttX tools repository.
#

config EXAMPLES_MOTOR_PWM_IO
	bool "motor pwm&io mode example"
	default n
	---help---
		Enable the motor pwm&io mode example

if EXAMPLES_MOTOR_PWM_IO

config EXAMPLES__MOTOR_PWM_IO_PROGNAME
	string "Program name"
	default "motor_pwm_io_example"
	---help---
		This is the name of the program that will be use when the NSH ELF
		program is installed.

config EXAMPLES_MOTOR_PWM_IO_PRIORITY
	int "motor pwm&io mode example task priority"
	default 100

config EXAMPLES_MOTOR_PWM_IO_STACKSIZE
	int "motor pwm&io mode example stack size"
	default 2048

endif
```

## apps/my_project/example/uorb_example/Kconfig
```kconfig
#
# For a description of the syntax of this configuration file,
# see the file kconfig-language.txt in the NuttX tools repository.
#

config EXAMPLES_UORB
	bool "uorb publish/subscribe example"
	default n
	---help---
		Enable the uorb publish/subscribe example

if EXAMPLES_UORB

config EXAMPLES_UORB_PROGNAME
	string "Program name"
	default "uorb_example"
	---help---
		This is the name of the program that will be use when the NSH ELF
		program is installed.

config EXAMPLES_UORB_PRIORITY
	int "uorb example task priority"
	default 100

config EXAMPLES_UORB_STACKSIZE
	int "uorb example stack size"
	default 2048

endif
```

## apps/my_project/imu/Kconfig
```kconfig
#
# For a description of the syntax of this configuration file,
# see the file kconfig-language.txt in the NuttX tools repository.
#

config MYPROJECT_IMU
	bool "imu task"
	default n
	---help---
		Enable the \"imu\" project

if MYPROJECT_IMU

config MYPROJECT_IMU_PROGNAME
	string "IMU"
	default "IMU"
	depends on BUILD_KERNEL
	---help---
		This is the name of the program that will be use when the NSH ELF
		program is installed.

config MYPROJECT_IMU_PRIORITY
	int "imu task priority"
	default 200

config MYPROJECT_IMU_STACKSIZE
	int "imu stack size"
	default 4096

endif
```

## apps/my_project/low_sensor_service/Kconfig
```kconfig
menu "low sensor service"



config LOW_SENSOR_TASK_PRIORITY
	int "low sensor service task priority"
	default 155
	range 100 250
	---help---
		motor service task priority, allowed values {100,250} 

config LOW_SENSOR_GPS
	bool "GPS sensor"
	default 1
	---help---
		Enable the GPS sensor

if LOW_SENSOR_GPS

config LOW_SENSOR_BUF_GPS
	int "GPS sensor read buffer length"
	default 1024
	range 50 2048
	---help---
		GPS sensor read buffer length, allowed values {50,2048} 

config LOW_SENSOR_GPS_PERIOD
	int "GPS sensor Publish timer(ms)"
	default 1000
	range 10 10000
	---help---
		GPS sensor publish timer, allowed values {10,10000} 

config LOW_SENSOR_GPS_RTK
	bool "GPS sensor use RTK"
	default 1
	---help---
		use the RTK GPS sensor,or use zhe board GPS sensor

config LOW_SENSOR_GPS_LOAD_ERR_VALUE
	bool "GPS uorb data no update set to a specitic error value"
	default 1
	---help---
		set zhe value to a spcitic error value ,when some of zhe publish uorb data is no updata

config SATE_POINT_BUFSIZE
	int "Satellite point struct bufer number"
	default 100
	range 1 10000
	---help---
		Satellite point struct bufer number, allowed values {1,10000} 

config GPS_CAL_SATE_POINT
	bool "Satellite point from GPS"
	default 1
	---help---
		use the GPS data calculate satellite point

config GPS_CAL_BEACON
	bool "Beacon frequecy and voltage from GPS and memory form"
	default 0
	---help---
		Beacon frequecy and voltage from GPS and memory form

endif


config LOW_SENSOR_TEMPERATURE
	bool "temperature sensor"
	default 1
	---help---
		Enable the temperature sensor

config LOW_SENSOR_FPPA_LED
	bool "System LED"
	default 1
	---help---
		Enable the LED output

if LOW_SENSOR_TEMPERATURE

config LOW_SENSOR_TEMPERATURE_PERIOD
	int "Temperature sensor Publish timer(ms)"
	default 1000
	range 100 10000
	---help---
		Temperature sensor publish timer, allowed values {100,10000} 

endif

endmenu # low sensor service
```

## apps/my_project/mavlink_service/Kconfig
```kconfig
#
# For a description of the syntax of this configuration file,
# see the file kconfig-language.txt in the NuttX tools repository.
#

config APP_MAVLINK_SERVICE
	bool "\"mavlink_service\" Application"
	default n
	---help---
		Enable the mavlink_service application

if APP_MAVLINK_SERVICE

config APP_MAVLINK_SERVICE_PROGNAME
	string "Program name"
	default "mavlink_service"
	---help---
		This is the name of the program that will be use when the NSH ELF
		program is installed.

config APP_MAVLINK_SERVICE_PRIORITY
	int "Task priority"
	default 100

config APP_MAVLINK_SERVICE_STACKSIZE
	int "Stack size"
	default 2048

choice
	prompt "Net Protocol"
	default UDP
	---help---
		choose the net protocol to send mavlink.

config  APP_MAVLINK_SERVICE_NET_PROTOCOL_UDP
	bool "UDP"
	---help---
		With this choice, your board will be a UDP server.

config  APP_MAVLINK_SERVICE_NET_PROTOCOL_TCP
	bool "TCP"
	---help---
		With this choice, your board will be a TCP server.

endchoice # Net Protocol


endif
```

## apps/my_project/motor_service/Kconfig
```kconfig
#
# For a description of the syntax of this configuration file,
# see the file kconfig-language.txt in the NuttX tools repository.
#
menu "motor_serveice"

choice 
	prompt "motor driver slect(Elmo/custom-485"
	default MOTOR_DRIVER_ELMO

	config 	MOTOR_DRIVER_ELMO
	bool "driver Elmo"
	select 	MOTOR_DRIVER_ELMO_1

	config 	MOTOR_DRIVER_CUSTOM_485
	bool "driver custom-485"
	select MOTOR_DRIVER_CUSTOM_485_1

endchoice

config CANOPEN_PROTOCOL_STACK
	bool "Canopen Protocol Stack"
	default 1
	---help---
		Enable the CANOPEN protocol stack

if CANOPEN_PROTOCOL_STACK

config MOTOR_TASK_PRIORITY
	int "MOTOR service task priority"
	default 200
	range 100 250
	---help---
		motor service task priority, allowed values {100,250} 

config MOTOR_READ_THREAD_PRIORITY
	int "MOTOR read thread priority"
	default 199
	range 100 250
	---help---
		motor read thread priority, allowed values {100,250} 

config MOTOR_USER_NO
	int "Motor device no"
	default 3
	range 1 6
	---help---
	how many number of zhe actual motor device

menu "Elmo driver"

config ELMO_AUTO_BACK_POSITION_TIME
	int "Elmo driver auto back position time"
	default 10
	range 0 1000
	---help---
		The interval time of Elmo driver auto back motor position,zhe unit is ms


endmenu # Elmo driver

config CANOPEN_PROTOCOL_STACK_PORT
	int "Port used for CANOPEN transmissions"
	default 0
	---help---
		Port used for MODBUS transmissions, default = 0 (i.e., /dev/ttyS0)

config CANOPEN_PROTOCOL_STACK_BAUD
	int "CANOPEN protocol stack baudrate"
	default 500000
	range 500000 1000000
	---help---
		canopen protocol stack baudrate, allowed values {500000,1000000}

endif



endmenu # motor_serveice
```

## apps/my_project/n25qxx_demo/Kconfig
```kconfig
#
# For a description of the syntax of this configuration file,
# see the file kconfig-language.txt in the NuttX tools repository.
#

config APP_N25QXX_DEMO
	bool "\"n25qxx_demo\" Application"
	default n
	---help---
		Enable the n25qxx_demo application

if APP_N25QXX_DEMO

config APP_N25QXX_DEMO_PROGNAME
	string "Program name"
	default "n25qxx_demo"
	---help---
		This is the name of the program that will be use when the NSH ELF
		program is installed.

config APP_N25QXX_DEMO_PRIORITY
	int "Task priority"
	default 100

config APP_N25QXX_DEMO_STACKSIZE
	int "Stack size"
	default 2048

endif
```

## apps/my_project/pc_control/Kconfig
```kconfig
menu "PC control"

config PC_CONTROL_MOTOR_DATA_BACK
	bool "PC contorl read motor data"
	default 1
	---help---
		Enable the pc_control task read motor data

if PC_CONTROL_MOTOR_DATA_BACK

config MOTOR_AUTO_BACK_INTERVAL
	int "motor auto back position data interval(ms)"
	default 0
	range 0 1000
	---help---
		 motor auto back position data interval,zhe range is{0,1000}
endif

config PC_CONTROL_BEACON_DATA_BACK
	bool "PC contorl read beacon data"
	default 1
	---help---
		Enable the pc_control task read beacon data
if PC_CONTROL_BEACON_DATA_BACK

config BEACON_AUTO_BACK_INTERVAL
	int "beacon auto back power data interval(times)"
	default 1
	range 1 1000
	---help---
		 motor auto back power data interval,zhe range is{1,1000}
endif


config PC_CONTROL_SATE_SET_BEACON
	bool "PC contorl satellite cmd control beacon"
	default 1
	---help---
		Enable the pc cmd to satellite control beacon frequency and voltage

config PC_CONTROL_TEMPERATURE_DATA_BACK
	bool "PC contorl read temperature data"
	default 1
	---help---
		Enable the pc_control task read temperature data

config PC_CONTROL_GPS_DATA_BACK
	bool "PC contorl read GPS data"
	default 1
	---help---
		Enable the pc_control task read GPS data

config PC_CONTROL_GPS_DATA_SEND_PC
	bool "PC contorl send GPS data to PC"
	default 0
	---help---
		Enable the pc_control task send GPS data to PC

config PC_CONTROL_SERVER_PORT
	int "PC control server port"
	default 50001
	range 0 65535
	---help---
		  pc contril tsak tcp/ip server port,zhe range is{0,1000}

config PC_CONTROL_LOAD_BEACON_DATA
	bool "PC contorl Load beacon data from pc to publish"
	default 0
	---help---
		Enable PC contorl Load beacon data from pc to publish

choice 
	prompt "network work mode(tcp/udp)"
	default USER_NETWORKMODE_TCP

	config 	USER_NETWORKMODE_TCP
	bool "TCP mode"
	select 	USER_NETWORKMODE_TCP_1

	config 	USER_NETWORKMODE_UDP
	bool "UDP mode"
	select USER_NETWORKMODE_UDP_1

endchoice

endmenu # PC control
```

## apps/my_project/satellite_attitude_control/Kconfig
```kconfig
#
# For a description of the syntax of this configuration file,
# see the file kconfig-language.txt in the NuttX tools repository.
#

config SATELLITE_ATTITUDE_CONTROL
	bool "satellite attitude control application"
	default n
	---help---
		Enable the satellite attitude control application

if SATELLITE_ATTITUDE_CONTROL

config SATELLITE_ATTITUDE_CONTROL_PROGNAME
	string "Program name"
	default "satellite attitude control"
	---help---
		This is the name of the program that will be use when the NSH ELF
		program is installed.

config SATELLITE_ATTITUDE_CONTROL_PRIORITY
	int "Task priority"
	default 100

config SATELLITE_ATTITUDE_CONTROL_STACKSIZE
	int "Stack size"
	default 2048

endif
```

## apps/my_project/satellite_signal_control/Kconfig
```kconfig
#
# For a description of the syntax of this configuration file,
# see the file kconfig-language.txt in the NuttX tools repository.
#

config SATELLITE_SIGNAL_CONTROL
	bool "satellite signal control application"
	default n
	---help---
		Enable the satellite signal control application

if SATELLITE_SIGNAL_CONTROL

config SATELLITE_SIGNAL_CONTROL_PROGNAME
	string "Program name"
	default "satellite signal control"
	---help---
		This is the name of the program that will be use when the NSH ELF
		program is installed.

config SATELLITE_SIGNAL_CONTROL_PRIORITY
	int "satellite signal control task priority"
	default 100

config SATELLITE_SIGNAL_CONTROL_STACKSIZE
	int "satellite signal control stack size"
	default 2048

endif
```
